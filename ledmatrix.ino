// ----------------------------------------------------------------------------
//   ledmatrix.ino
// ----------------------------------------------------------------------------

// first version: summer 2008
//
// this release:
// - compiled with arduino 1.8.5
// - hardware used: arduino diecimila

// --- configuration and system defaults --------------------------------------

#define REP 123  // frame repetitions
#define PAU 27   // inter-scanline pause

bool reverse = true;  // if true, orientation is towards usb plug


// --- font -------------------------------------------------------------------

const unsigned char font[] PROGMEM = {
   0x00, 0x00, 0x00, 0x00, 0x00, 0x00,  //  32 (0x20): " "
   0x00, 0x00, 0xfa, 0x00, 0x00, 0x00,  //  33 (0x21): "!"
   0x00, 0xe0, 0x00, 0xe0, 0x00, 0x00,  //  34 (0x22): '"'
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   0x28, 0x7c, 0xaa, 0xaa, 0xaa, 0x00,  // 138 (0x8a): euro symbol
};

#define LASTCHAR ((sizeof(font)/6)+31)


// --- direct pin manipulation ------------------------------------------------

inline void xon0()   { PORTC |= B00001000; };
inline void xon1()   { PORTC |= B00000100; };
inline void xon2()   { PORTC |= B00000001; };
inline void xon3()   { PORTC |= B00000010; };
inline void xon4()   { PORTD |= B00100000; };
inline void xon5()   { PORTD |= B00010000; };
inline void xon6()   { PORTD |= B00001000; };
inline void xon7()   { PORTD |= B00000100; };
inline void xoff0()  { PORTC &= B11110111; };
inline void xoff1()  { PORTC &= B11111011; };
inline void xoff2()  { PORTC &= B11111110; };
inline void xoff3()  { PORTC &= B11111101; };
inline void xoff4()  { PORTD &= B11011111; };
inline void xoff5()  { PORTD &= B11101111; };
inline void xoff6()  { PORTD &= B11110111; };
inline void xoff7()  { PORTD &= B11111011; };

inline void xon()    { PORTD |= B00111100; PORTC |= B00001111; };
inline void xoff()   { PORTD &= B11000011; PORTC &= B11110000; };

inline void yon0()   { PORTB |= B00100000; };
inline void yon1()   { PORTB |= B00010000; };
inline void yon2()   { PORTB |= B00001000; };
inline void yon3()   { PORTB |= B00000100; };
inline void yon4()   { PORTB |= B00000010; };
inline void yon5()   { PORTB |= B00000001; };
inline void yon6()   { PORTD |= B10000000; };
inline void yon7()   { PORTD |= B01000000; };
inline void yoff0()  { PORTB &= B11011111; };
inline void yoff1()  { PORTB &= B11101111; };
inline void yoff2()  { PORTB &= B11110111; };
inline void yoff3()  { PORTB &= B11111011; };
inline void yoff4()  { PORTB &= B11111101; };
inline void yoff5()  { PORTB &= B11111110; };
inline void yoff6()  { PORTD &= B01111111; };
inline void yoff7()  { PORTD &= B10111111; };

inline void yoff()   { PORTB &= B11000000; PORTD &= B00111111; };
inline void yon()    { PORTB |= B00111111; PORTD |= B11000000; };


inline void column(unsigned char valore)
{
  register int v = valore;
  xon();
  if(reverse)
  {
    if(v&1)   xoff7();
    if(v&2)   xoff6();
    if(v&4)   xoff5();
    if(v&8)   xoff4();
    if(v&16)  xoff3();
    if(v&32)  xoff2();
    if(v&64)  xoff1();
    if(v&128) xoff0();
  }
  else
  {
    if(v&1)   xoff0();
    if(v&2)   xoff1();
    if(v&4)   xoff2();
    if(v&8)   xoff3();
    if(v&16)  xoff4();
    if(v&32)  xoff5();
    if(v&64)  xoff6();
    if(v&128) xoff7();
  }
}


// --- main -------------------------------------------------------------------

unsigned char* p, buffer[512];
const unsigned nmax = sizeof(buffer)-5;
unsigned z = 0;

void setup()
{
  DDRD |= B11111100;
  DDRB |= B00111111;
  DDRC |= B00001111;

  Serial.begin(9600);
  delay(100);
  Serial.println("!--ledmatrix");

  p = buffer;
  *p++ = ' ';
  *p++ = ' ';
  *p++ = 'O';
  *p++ = 'K';
  
#ifdef DEBUG  
  *p++ = ' '; for(unsigned e='!'; e<=LASTCHAR; e++) *p++=e;
#endif

  *p++ = ' ';
  *p++ = ' ';
  *p = 0;
  p = buffer;  
}


void loop()
{
  unsigned c, i, n, q;
  for(;;)
  {
    if(Serial.available())
    {
      for(q=1, n=2, p=buffer+2; q;)
      {
        c=Serial.read();
        switch(c)
        {
          case 0xc3:   // unicode
            switch(Serial.read())
            {
              case 0xa7: while(Serial.available()) Serial.read();
                         setup();
                         return; // reboot se uno dei caratteri era "ç"
              
              case 0xa0: c = 0x80; break; // à
              case 0xa8: c = 0x81; break; // è
              case 0xa9: c = 0x82; break; // é
              case 0xac: c = 0x83; break; // ì
              case 0xb2: c = 0x84; break; // ò
              case 0xb9: c = 0x85; break; // ù

              case 0xb8: c = 0x8a; break; // € from the character ø (altgr-o in ubuntu mapping)

              // comandi:

              case 0xb6: reverse = true;  // ë: reverse scrolling 
                         continue;

              case 0xab: reverse = false; // ö: normal scrolling
                         continue;

              default:   c = '?';
            }  // then, cascading:

          case 32 ... LASTCHAR :
            *p++ = c;
            n++;
#ifdef DEBUG            
            if(c<127) Serial.print((char)c);
            else { Serial.print("["); Serial.print(c); Serial.print("]"); }
#endif
            if(n >= nmax) q = 0;
            break;

          case '\n':
            q = 0;
#ifdef DEBUG
            Serial.print("-->");
#endif
            break;

          default: break;
        }
      }
      Serial.println("OK");
      *p++ = ' ';
      *p = 0;
      p = buffer;
      z = 0;
      xon();
      yon();
    }

     
    for(i=REP; i; i--)
    {
      register unsigned o = z;
      register unsigned char* v = p;

#define col()    column(pgm_read_byte(font + 6*(*v-' ') + o)) // using "v" and "o" variables
#define spara(k) col(); yon##k(); delayMicroseconds(PAU); if(++o==6) { o=0; v++; } yoff##k()

      if(reverse)
      {
        spara(7);
        spara(6);
        spara(5);
        spara(4);
        spara(3);
        spara(2);
        spara(1);
        spara(0);
      }
      else
      {
        spara(0);
        spara(1);
        spara(2);
        spara(3);
        spara(4);
        spara(5);
        spara(6);
        spara(7);
      }
    }

    if(++z >= 6)
    {
      z = 0;
      p++;
      if(p[2]=='\0')
      {
        p = buffer;
      }
    }
  }
}

// ---
